
qcom,3292665_huaqin_ql1626cos_5000mah_averaged_masterslave_jan8th2018 {
	qcom, = <24>;
	/* #3292665_Huaqin_QL1626cos_5000mAh_averaged_MasterSlave_Jan8th2018*/
	qcom,max-voltage-uv = <4350000>;
	qcom,nom-batt-capacity-mah = <5000>;
	qcom,batt-id-kohm = <51>;
	qcom,battery-beta = <3435>;
	qcom,fg-cc-cv-threshold-mv = <4340>;
	qcom,battery-type = "3292665_huaqin_ql1626cos_5000mah_averaged_masterslave_jan8th2018";
	qcom,checksum = <0x9FF6>;
	qcom,gui-version = "PM660GUI - 0.0.0.45";
	qcom,fg-profile-data = [
		 D5 1E 1B FD
		 3A 03 AA F4
		 E1 1C D7 FB
		 C0 0D 8B 0A
		 D1 17 68 23
		 25 45 48 53
		 6F 00 00 00
		 12 00 00 00
		 00 00 3D C4
		 92 C5 3E CA
		 18 00 08 00
		 27 E2 7C E5
		 D8 05 7F 01
		 82 02 BD 1A
		 A3 CC 6D 2A
		 25 06 09 20
		 27 00 14 00
		 40 1F 3C 06
		 B9 03 C9 FD
		 AB 1C 44 03
		 AA 15 8E 12
		 6D 18 10 2A
		 93 4D F6 5B
		 62 00 00 00
		 0D 00 00 00
		 00 00 7D D5
		 D1 C3 79 CA
		 12 00 00 00
		 E3 E2 7C E5
		 8D 06 F5 00
		 8B FD AA 03
		 15 FD F5 13
		 99 33 CC FF
		 07 10 00 00
		 14 13 99 45
		 12 00 40 00
		 97 01 0A FA
		 FF 00 00 00
		 00 00 00 00
		 00 00 00 00
		 00 00 00 00
		 00 00 00 00
		 00 00 00 00
		 00 00 00 00
		 00 00 00 00
		 00 00 00 00
		 00 00 00 00
		 00 00 00 00
		 00 00 00 00
		 00 00 00 00
		 00 00 00 00
		 00 00 00 00
		 00 00 00 00
		 00 00 00 00
		 00 00 00 00
		 00 00 00 00
	];
};
