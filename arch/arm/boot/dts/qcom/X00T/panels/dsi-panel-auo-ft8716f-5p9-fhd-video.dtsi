/* Copyright (c) 2013, The Linux Foundation. All rights reserved.
 *
 * This program is free software; you can redistribute it and/or modify
 * it under the terms of the GNU General Public License version 2 and
 * only version 2 as published by the Free Software Foundation.
 *
 * This program is distributed in the hope that it will be useful,
 * but WITHOUT ANY WARRANTY; without even the implied warranty of
 * MERCHANTABILITY or FITNESS FOR A PARTICULAR PURPOSE.  See the
 * GNU General Public License for more details.
 */

&mdss_mdp {
	dsi_auo_ft8716f_5p9_fhd_video:qcom,mdss_dsi_auo_ft8716f_5p9_fhd_video {
		qcom,mdss-dsi-panel-name = "AUO_FT8716F_5P9_FHD_VIDEO";
		qcom,cont-splash-enabled;
		qcom,panel-supply-entries = <&dsi_panel_pwr_supply>;
		qcom,mdss-dsi-panel-controller = <&mdss_dsi0>;
		qcom,mdss-dsi-panel-type = "dsi_video_mode";
		qcom,mdss-dsi-panel-destination = "display_1";
		qcom,mdss-dsi-panel-framerate = <60>;
		qcom,mdss-dsi-virtual-channel-id = <0>;
		qcom,mdss-dsi-stream = <0>;
		qcom,mdss-dsi-panel-width = <1080>;
		qcom,mdss-dsi-panel-height = <2246>;
		qcom,mdss-dsi-h-front-porch = <32>;
		qcom,mdss-dsi-h-back-porch = <32>;
		qcom,mdss-dsi-h-pulse-width = <8>;
		qcom,mdss-dsi-h-sync-skew = <0>;
		qcom,mdss-dsi-v-back-porch = <16>;
		qcom,mdss-dsi-v-front-porch = <16>;
		qcom,mdss-dsi-v-pulse-width = <2>;
		qcom,mdss-dsi-h-left-border = <0>;
		qcom,mdss-dsi-h-right-border = <0>;
		qcom,mdss-dsi-v-top-border = <0>;
		qcom,mdss-dsi-v-bottom-border = <0>;
		qcom,mdss-dsi-bpp = <24>;
		qcom,mdss-dsi-color-order = "rgb_swap_rgb";
		qcom,mdss-dsi-underflow-color = <0xff>;
		qcom,mdss-dsi-border-color = <0>;
		qcom,mdss-dsi-on-command = [
			/*39 01 00 00 00 00 02 00 00
                        39 01 00 00 00 00 04 FF 87 16 01
                        39 01 00 00 00 00 02 00 80
                        39 01 00 00 00 00 03 FF 87 16

                        39 01 00 00 00 00 02 00 00
                        39 01 00 00 00 00 05 2A 00 00 04 37
                        39 01 00 00 00 00 02 00 00
                        39 01 00 00 00 00 05 2B 00 00 08 C5

			39 01 00 00 00 00 02 00 00
                        39 01 00 00 00 00 04 FF 00 00 00 00 
                        15 01 00 00 00 00 02 00 80
                        15 01 00 00 00 00 03 FF 00 00
			39 01 00 00 00 00 02 35 00*/

                        05 01 00 00 78 00 01 11
                        05 01 00 00 1E 00 01 29];
		qcom,mdss-dsi-off-command = [
			05 01 00 00 1C 00 01 28
                        05 01 00 00 64 00 01 10];
		qcom,mdss-dsi-panel-timings-phy-v2 = [
			24 1F 08 09 05 03 04 A0
			24 1F 08 09 05 03 04 A0
			24 1F 08 09 05 03 04 A0
			24 1F 08 09 05 03 04 A0
			24 1C 08 09 05 03 04 A0];
		qcom,mdss-dsi-tx-eot-append;
		//qcom,esd-check-enabled;
		qcom,mdss-dsi-panel-status-check-mode = "reg_read";
		qcom,mdss-dsi-panel-status-read-length = <1>;
		qcom,mdss-dsi-panel-status-command = [06 01 00 01 05 00 01 0A];
		qcom,mdss-dsi-panel-status-command-state = "dsi_lp_mode";
		qcom,mdss-dsi-panel-status-value = <0x9C>;
		qcom,mdss-dsi-on-command-state = "dsi_lp_mode";
		qcom,mdss-dsi-off-command-state = "dsi_hs_mode";
		qcom,mdss-dsi-h-sync-pulse = <1>;
		qcom,mdss-dsi-traffic-mode = "burst_mode";
		qcom,mdss-dsi-lane-map = "lane_map_0123";
		qcom,mdss-dsi-bllp-eof-power-mode;
		qcom,mdss-dsi-bllp-power-mode;
		qcom,mdss-dsi-lp11-init;
		qcom,mdss-dsi-init-delay-us = <10000>;
		qcom,mdss-dsi-lane-0-state;
		qcom,mdss-dsi-lane-1-state;
		qcom,mdss-dsi-lane-2-state;
		qcom,mdss-dsi-lane-3-state;
		qcom,mdss-dsi-panel-timings = [f7 3a 28 00 6e 72 2c 3e 31 03 04 00];
		qcom,mdss-dsi-t-clk-post = <0x0e>;
		qcom,mdss-dsi-t-clk-pre = <0x31>;
		qcom,mdss-dsi-bl-min-level = <1>;
		qcom,mdss-dsi-bl-max-level = <4095>;
		qcom,mdss-dsi-dma-trigger = "trigger_sw";
		qcom,mdss-dsi-mdp-trigger = "none";
		qcom,mdss-dsi-bl-pmic-control-type = "bl_ctrl_wled";
		qcom,mdss-dsi-reset-sequence = <1 20>, <0 2>, <1 20>;
	};
};
