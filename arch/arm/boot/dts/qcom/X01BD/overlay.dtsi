/* SPDX-License-Identifier: GPL-2.0 */

#include "sdm660-overlay.dtsi"
#include "sdm660-mdss-overlay.dtsi"
#include "msm-pm660-overlay.dtsi"
#include "msm-pm660l-overlay.dtsi"
#include "msm-pm660l-rpm-regulator-overlay.dtsi"
#include "sdm660-regulator-overlay.dtsi"
#include "sdm660-common-overlay.dtsi"
#include "sdm660-camera-overlay.dtsi"
#include "msm-audio-overlay.dtsi"
#include "sdm660-audio-overlay.dtsi"
#include "sdm660-lpi-overlay.dtsi"
#include "dsi-panel-nt36672ah-1080p-video-kd.dtsi"
#include "dsi-panel-hx83112a-1080p-video-tm.dtsi"
