/* Copyright (c) 2013, The Linux Foundation. All rights reserved.
 *
 * This  program is free software; you can redistribute it and/or modify
 * it under the terms of the GNU General Public License version 2 and
 * only version 2 as published by the Free Software Foundation.
 *
 * This program is distributed in the hope that it will be useful,
 * but WITHOUT ANY WARRANTY; without even the implied warranty of
 * MERCHANTABILITY or FITNESS FOR A PARTICULAR PURPOSE.  See the
 * GNU General Public License for more details.
 */

/*---------------------------------------------------------------------------
 * This file is autogenerated file using gcdb parser. Please do not edit it.
 * Update input XML file to add a new entry or update variable in this file
 * VERSION = "1.0"
 *---------------------------------------------------------------------------*/
&mdss_mdp {
	dsi_nt36672ah_1080p_video_kd: qcom,mdss_dsi_nt36672ah_1080p_video_kd {
		qcom,mdss-dsi-panel-name = "nt36672ah 1080p video mode dsi kd panel";
		qcom,mdss-dsi-panel-controller = <&mdss_dsi0>;
		qcom,mdss-dsi-panel-type = "dsi_video_mode";
		qcom,mdss-dsi-panel-destination = "display_1";
		qcom,mdss-dsi-panel-framerate = <60>;
		qcom,mdss-dsi-virtual-channel-id = <0>;
		qcom,mdss-dsi-stream = <0>;
		qcom,mdss-dsi-panel-width = <1080>;
		qcom,mdss-dsi-panel-height = <2280>;
		qcom,mdss-pan-physical-width-dimension = <68>;
		qcom,mdss-pan-physical-height-dimension = <143>;
		qcom,mdss-dsi-h-front-porch = <120>;
		qcom,mdss-dsi-h-back-porch = <120>;
		qcom,mdss-dsi-h-pulse-width = <8>;
		qcom,mdss-dsi-h-sync-skew = <0>;
		qcom,mdss-dsi-v-back-porch = <8>;
		qcom,mdss-dsi-v-front-porch = <10>;
		qcom,mdss-dsi-v-pulse-width = <2>;
		qcom,mdss-dsi-h-left-border = <0>;
		qcom,mdss-dsi-h-right-border = <0>;
		qcom,mdss-dsi-v-top-border = <0>;
		qcom,mdss-dsi-v-bottom-border = <0>;
		qcom,mdss-dsi-bpp = <24>;
		qcom,ulps-enabled;
		qcom,panel-allow-phy-poweroff;
		qcom,mdss-dsi-color-order = "rgb_swap_rgb";
		qcom,mdss-dsi-underflow-color = <0xff>;
		qcom,mdss-dsi-border-color = <0>;
		qcom,mdss-dsi-on-command = [15 01 00 00 00 00 02 FF 10
			15 01 00 00 00 00 02 FB 01
			15 01 00 00 00 00 02 FF 20
			15 01 00 00 00 00 02 FB 01
			15 01 00 00 00 00 02 07 9E
			15 01 00 00 00 00 02 0F A4
			15 01 00 00 00 00 02 62 BD
			15 01 00 00 00 00 02 6D 44
			15 01 00 00 00 00 02 78 01
			15 01 00 00 00 00 02 FF 24
			15 01 00 00 00 00 02 FB 01
			15 01 00 00 00 00 02 00 1C
			15 01 00 00 00 00 02 01 1C
			15 01 00 00 00 00 02 02 1C
			15 01 00 00 00 00 02 03 1C
			15 01 00 00 00 00 02 04 1C
			15 01 00 00 00 00 02 05 1C
			15 01 00 00 00 00 02 06 1C
			15 01 00 00 00 00 02 07 1C
			15 01 00 00 00 00 02 08 1C
			15 01 00 00 00 00 02 09 1C
			15 01 00 00 00 00 02 0A 20
			15 01 00 00 00 00 02 0C 10
			15 01 00 00 00 00 02 0D 12
			15 01 00 00 00 00 02 0E 14
			15 01 00 00 00 00 02 0F 1E
			15 01 00 00 00 00 02 10 0D
			15 01 00 00 00 00 02 11 0A
			15 01 00 00 00 00 02 12 01
			15 01 00 00 00 00 02 13 03
			15 01 00 00 00 00 02 14 04
			15 01 00 00 00 00 02 15 05
			15 01 00 00 00 00 02 16 06
			15 01 00 00 00 00 02 17 1C
			15 01 00 00 00 00 02 18 1C
			15 01 00 00 00 00 02 19 1C
			15 01 00 00 00 00 02 1A 1C
			15 01 00 00 00 00 02 1B 1C
			15 01 00 00 00 00 02 1C 1C
			15 01 00 00 00 00 02 1D 1C
			15 01 00 00 00 00 02 1E 1C
			15 01 00 00 00 00 02 1F 1C
			15 01 00 00 00 00 02 20 1C
			15 01 00 00 00 00 02 21 20
			15 01 00 00 00 00 02 22 00
			15 01 00 00 00 00 02 23 10
			15 01 00 00 00 00 02 24 12
			15 01 00 00 00 00 02 25 14
			15 01 00 00 00 00 02 26 1E
			15 01 00 00 00 00 02 27 0D
			15 01 00 00 00 00 02 28 0A
			15 01 00 00 00 00 02 29 01
			15 01 00 00 00 00 02 2A 03
			15 01 00 00 00 00 02 2B 04
			15 01 00 00 00 00 02 2D 05
			15 01 00 00 00 00 02 2F 06
			15 01 00 00 00 00 02 31 06
			15 01 00 00 00 00 02 32 0A
			15 01 00 00 00 00 02 33 04
			15 01 00 00 00 00 02 34 02
			15 01 00 00 00 00 02 35 49
			15 01 00 00 00 00 02 37 00
			15 01 00 00 00 00 02 38 69
			15 01 00 00 00 00 02 39 69
			15 01 00 00 00 00 02 3F 69
			15 01 00 00 00 00 02 41 06
			15 01 00 00 00 00 02 42 0A
			15 01 00 00 00 00 02 4C 09
			15 01 00 00 00 00 02 4D 09
			15 01 00 00 00 00 02 61 E8
			15 01 00 00 00 00 02 72 00
			15 01 00 00 00 00 02 73 00
			15 01 00 00 00 00 02 74 00
			15 01 00 00 00 00 02 75 00
			15 01 00 00 00 00 02 79 00
			15 01 00 00 00 00 02 7B 9B
			15 01 00 00 00 00 02 7C 80
			15 01 00 00 00 00 02 7D 06
			15 01 00 00 00 00 02 80 42
			15 01 00 00 00 00 02 82 11
			15 01 00 00 00 00 02 83 22
			15 01 00 00 00 00 02 84 33
			15 01 00 00 00 00 02 85 00
			15 01 00 00 00 00 02 86 00
			15 01 00 00 00 00 02 87 00
			15 01 00 00 00 00 02 88 11
			15 01 00 00 00 00 02 89 22
			15 01 00 00 00 00 02 8A 33
			15 01 00 00 00 00 02 8B 00
			15 01 00 00 00 00 02 8C 00
			15 01 00 00 00 00 02 8D 00
			15 01 00 00 00 00 02 92 75
			15 01 00 00 00 00 02 B3 0A
			15 01 00 00 00 00 02 B4 0A
			15 01 00 00 00 00 02 DC 29
			15 01 00 00 00 00 02 DD 04
			15 01 00 00 00 00 02 DE 02
			15 01 00 00 00 00 02 DF 70
			15 01 00 00 00 00 02 E0 00
			15 01 00 00 00 00 02 FF 25
			15 01 00 00 00 00 02 FB 01
			15 01 00 00 00 00 02 21 1B
			15 01 00 00 00 00 02 22 1B
			15 01 00 00 00 00 02 24 75
			15 01 00 00 00 00 02 25 75
			15 01 00 00 00 00 02 30 2F
			15 01 00 00 00 00 02 38 2F
			15 01 00 00 00 00 02 3F 21
			15 01 00 00 00 00 02 40 6D
			15 01 00 00 00 00 02 4B 21
			15 01 00 00 00 00 02 4C 6D
			15 01 00 00 00 00 02 BF 00
			15 01 00 00 00 00 02 C3 13
			15 01 00 00 00 00 02 FF 26
			15 01 00 00 00 00 02 FB 01
			15 01 00 00 00 00 02 06 FF
			15 01 00 00 00 00 02 12 72
			15 01 00 00 00 00 02 1A 67
			15 01 00 00 00 00 02 1C AF
			15 01 00 00 00 00 02 1E EA
			15 01 00 00 00 00 02 98 F1
			15 01 00 00 00 00 02 A9 11
			15 01 00 00 00 00 02 AA 11
			15 01 00 00 00 00 02 AE 8A
			15 01 00 00 00 00 02 FF 27
			15 01 00 00 00 00 02 FB 01
			15 01 00 00 00 00 02 13 00
			15 01 00 00 00 00 02 1E 15
			15 01 00 00 00 00 02 FF F0
			15 01 00 00 00 00 02 FB 01
			15 01 00 00 00 00 02 A2 00
			15 01 00 00 00 00 02 FF 20
			15 01 00 00 00 00 02 FB 01
			39 01 00 00 00 00 11 B0 00 00 00 01 00 32 00 4C 00 63 00 77 00 8B 00 9C
			39 01 00 00 00 00 11 B1 00 AC 00 E5 01 0F 01 51 01 80 01 CE 02 09 02 0C
			39 01 00 00 00 00 11 B2 02 48 02 90 02 C1 02 F9 03 20 03 4B 03 5B 03 69
			39 01 00 00 00 00 0D B3 03 7B 03 8F 03 A6 03 BE 03 C0 03 CD
			39 01 00 00 00 00 11 B4 00 00 00 01 00 32 00 4C 00 63 00 77 00 8B 00 9C
			39 01 00 00 00 00 11 B5 00 AC 00 E5 01 0F 01 51 01 80 01 CE 02 09 02 0C
			39 01 00 00 00 00 11 B6 02 48 02 90 02 C1 02 F9 03 20 03 4B 03 5B 03 69
			39 01 00 00 00 00 0D B7 03 7B 03 8F 03 A6 03 BE 03 C0 03 CD
			39 01 00 00 00 00 11 B8 00 00 00 01 00 32 00 4C 00 63 00 77 00 8B 00 9C
			39 01 00 00 00 00 11 B9 00 AC 00 E5 01 0F 01 51 01 80 01 CE 02 09 02 0C
			39 01 00 00 00 00 11 BA 02 48 02 90 02 C1 02 F9 03 20 03 4B 03 5B 03 69
			39 01 00 00 00 00 0D BB 03 7B 03 8F 03 A6 03 BE 03 C0 03 CD
			15 01 00 00 00 00 02 FF 21
			15 01 00 00 00 00 02 FB 01
			39 01 00 00 00 00 11 B0 00 00 00 01 00 32 00 4C 00 63 00 77 00 8B 00 9C
			39 01 00 00 00 00 11 B1 00 AC 00 E5 01 0F 01 51 01 80 01 CE 02 09 02 0C
			39 01 00 00 00 00 11 B2 02 48 02 90 02 C1 02 F9 03 20 03 4B 03 5B 03 69
			39 01 00 00 00 00 0D B3 03 7B 03 8F 03 A6 03 BE 03 C0 03 CD
			39 01 00 00 00 00 11 B4 00 00 00 01 00 32 00 4C 00 63 00 77 00 8B 00 9C
			39 01 00 00 00 00 11 B5 00 AC 00 E5 01 0F 01 51 01 80 01 CE 02 09 02 0C
			39 01 00 00 00 00 11 B6 02 48 02 90 02 C1 02 F9 03 20 03 4B 03 5B 03 69
			39 01 00 00 00 00 0D B7 03 7B 03 8F 03 A6 03 BE 03 C0 03 CD
			39 01 00 00 00 00 11 B8 00 00 00 01 00 32 00 4C 00 63 00 77 00 8B 00 9C
			39 01 00 00 00 00 11 B9 00 AC 00 E5 01 0F 01 51 01 80 01 CE 02 09 02 0C
			39 01 00 00 00 00 11 BA 02 48 02 90 02 C1 02 F9 03 20 03 4B 03 5B 03 69
			39 01 00 00 00 00 0D BB 03 7B 03 8F 03 A6 03 BE 03 C0 03 CD
			15 01 00 00 00 00 02 FF 20
			15 01 00 00 00 00 02 FB 01
			15 01 00 00 00 00 02 78 01
			15 01 00 00 00 00 02 FF 26
			15 01 00 00 00 00 02 FB 01
			15 01 00 00 00 00 02 1C FA
			15 01 00 00 00 00 02 AE 8A
			15 01 00 00 00 00 02 FF 10
			15 01 00 00 00 00 02 FB 01
			15 01 00 00 00 00 02 51 FF
			15 01 00 00 00 00 02 53 24
			15 01 00 00 00 00 02 55 00
			05 01 00 00 64 00 01 11
			05 01 00 00 14 00 01 29];
		qcom,mdss-dsi-off-command = [05 01 00 00 32 00 02 28 00
					05 01 00 00 78 00 02 10 00];
		qcom,mdss-dsi-esd-recover-command = [39 01 00 00 00 00 02 4F 01];
		qcom,mdss-dsi-on-command-state = "dsi_lp_mode";
		qcom,mdss-dsi-off-command-state = "dsi_lp_mode";
		qcom,mdss-dsi-esd-recover-command-state = "dsi_lp_mode";
		qcom,mdss-dsi-h-sync-pulse = <1>;
		qcom,mdss-dsi-traffic-mode = "burst_mode";
		qcom,mdss-dsi-lane-map = "lane_map_0123";
		qcom,mdss-dsi-bllp-eof-power-mode;
		qcom,mdss-dsi-bllp-power-mode;
		qcom,mdss-dsi-lane-0-state;
		qcom,mdss-dsi-lane-1-state;
		qcom,mdss-dsi-lane-2-state;
		qcom,mdss-dsi-lane-3-state;
		qcom,mdss-dsi-panel-timings-phy-v2 = [26 21 09 0B 06 03 04 a0
		26 21 09 0B 06 03 04 a0
		26 21 09 0B 06 03 04 a0
		26 21 09 0B 06 03 04 a0
		26 20 0A 0B 06 03 04 a0];
		qcom,mdss-dsi-t-clk-post = <0x0F>;
		qcom,mdss-dsi-t-clk-pre = <0x37>;
		qcom,mdss-dsi-bl-min-level = <1>;
		qcom,mdss-dsi-bl-max-level = <4095>;
		qcom,mdss-dsi-dma-trigger = "trigger_sw";
		qcom,mdss-dsi-mdp-trigger = "none";
		qcom,mdss-dsi-bl-pmic-control-type = "bl_ctrl_wled";
		qcom,mdss-dsi-reset-sequence = <1 10>, <0 10>, <1 20>;
		qcom,mdss-dsi-lp11-init;
		qcom,esd-check-enabled;
		qcom,mdss-dsi-panel-status-command = [06 01 00 01 05 00 01 0A];
		qcom,mdss-dsi-panel-status-command-mode = "dsi_hs_mode";
		qcom,mdss-dsi-panel-status-check-mode = "reg_read";
		qcom,mdss-dsi-panel-status-read-length = <1>;
		qcom,mdss-dsi-panel-status-value = <0x9C>;
		qcom,mdss-dsi-panel-max-error-count = <3>;
	};
};
