/*
 * Copyright (c) 2019, The Linux Foundation. All rights reserved.
 *
 * This program is free software; you can redistribute it and/or modify
 * it under the terms of the GNU General Public License version 2 and
 * only version 2 as published by the Free Software Foundation.
 *
 * This program is distributed in the hope that it will be useful,
 * but WITHOUT ANY WARRANTY; without even the implied warranty of
 * MERCHANTABILITY or FITNESS FOR A PARTICULAR PURPOSE.  See the
 * GNU General Public License for more details.
 */

#include "X00T-panels.dtsi"
#include "X00T-general.dtsi"
#include "X00T-touchscreens.dtsi"
#include "X00T-camera-sensor.dtsi"
#include "X00T-audio.dtsi"
#include "X00T-memory.dtsi"
#include "X00T-pinctrl.dtsi"
#include "X00T-tweaks.dtsi"
