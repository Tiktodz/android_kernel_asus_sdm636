/* Copyright (c) 2013, The Linux Foundation. All rights reserved.
 *
 * This  program is free software; you can redistribute it and/or modify
 * it under the terms of the GNU General Public License version 2 and
 * only version 2 as published by the Free Software Foundation.
 *
 * This program is distributed in the hope that it will be useful,
 * but WITHOUT ANY WARRANTY; without even the implied warranty of
 * MERCHANTABILITY or FITNESS FOR A PARTICULAR PURPOSE.  See the
 * GNU General Public License for more details.
 */

/*---------------------------------------------------------------------------
 * This file is autogenerated file using gcdb parser. Please do not edit it.
 * Update input XML file to add a new entry or update variable in this file
 * VERSION = "1.0"
 *---------------------------------------------------------------------------*/
&mdss_mdp {
	dsi_nt36672_1080p_video_txd: qcom,mdss_dsi_nt36672_1080p_video_txd {
		qcom,mdss-dsi-panel-name = "nt36672 1080p video mode dsi txd panel";
		qcom,mdss-dsi-panel-controller = <&mdss_dsi0>;
		qcom,mdss-dsi-panel-type = "dsi_video_mode";
		qcom,mdss-dsi-panel-destination = "display_1";
		qcom,mdss-dsi-panel-framerate = <60>;
		qcom,mdss-dsi-virtual-channel-id = <0>;
		qcom,mdss-dsi-stream = <0>;
		qcom,mdss-dsi-panel-width = <1080>;
		qcom,mdss-dsi-panel-height = <2160>;
		qcom,mdss-pan-physical-width-dimension = <68>;
		qcom,mdss-pan-physical-height-dimension = <136>;
		qcom,mdss-dsi-h-front-porch = <122>;
		qcom,mdss-dsi-h-back-porch = <76>;
		qcom,mdss-dsi-h-pulse-width = <8>;
		qcom,mdss-dsi-h-sync-skew = <0>;
		qcom,mdss-dsi-v-back-porch = <28>;
		qcom,mdss-dsi-v-front-porch = <20>;
		qcom,mdss-dsi-v-pulse-width = <4>;
		qcom,mdss-dsi-h-left-border = <0>;
		qcom,mdss-dsi-h-right-border = <0>;
		qcom,mdss-dsi-v-top-border = <0>;
		qcom,mdss-dsi-v-bottom-border = <0>;
		qcom,mdss-dsi-bpp = <24>;
		qcom,mdss-dsi-color-order = "rgb_swap_rgb";
		qcom,mdss-dsi-underflow-color = <0xff>;
		qcom,mdss-dsi-border-color = <0>;
		qcom,mdss-dsi-on-command = [39 01 00 00 00 00 02 FF 20
			39 01 00 00 00 00 02 FB 01
			39 01 00 00 00 00 02 06 9E
			39 01 00 00 00 00 02 07 94
			39 01 00 00 00 00 02 0E 35
			39 01 00 00 00 00 02 0F 24
			39 01 00 00 00 00 02 6D 66
			39 01 00 00 00 00 02 69 99
			39 01 00 00 00 00 02 95 F5
			39 01 00 00 00 00 02 96 F5
			39 01 00 00 00 00 02 FF 23
			39 01 00 00 00 00 02 FB 01
			39 01 00 00 00 00 02 12 6C
			39 01 00 00 00 00 02 15 E6
			39 01 00 00 00 00 02 16 0C
			39 01 00 00 00 00 02 FF 24
			39 01 00 00 00 00 02 FB 01
			39 01 00 00 00 00 02 00 20
			39 01 00 00 00 00 02 01 20
			39 01 00 00 00 00 02 02 20
			39 01 00 00 00 00 02 03 01
			39 01 00 00 00 00 02 04 0B
			39 01 00 00 00 00 02 05 0C
			39 01 00 00 00 00 02 06 A9
			39 01 00 00 00 00 02 07 06
			39 01 00 00 00 00 02 08 04
			39 01 00 00 00 00 02 09 20
			39 01 00 00 00 00 02 0A 0F
			39 01 00 00 00 00 02 0B 20
			39 01 00 00 00 00 02 0C 20
			39 01 00 00 00 00 02 0D 20
			39 01 00 00 00 00 02 0E 20
			39 01 00 00 00 00 02 0F 17
			39 01 00 00 00 00 02 10 15
			39 01 00 00 00 00 02 11 13
			39 01 00 00 00 00 02 12 00
			39 01 00 00 00 00 02 13 00
			39 01 00 00 00 00 02 14 20
			39 01 00 00 00 00 02 15 01
			39 01 00 00 00 00 02 16 0B
			39 01 00 00 00 00 02 17 0C
			39 01 00 00 00 00 02 18 A9
			39 01 00 00 00 00 02 19 05
			39 01 00 00 00 00 02 1A 03
			39 01 00 00 00 00 02 1B 20
			39 01 00 00 00 00 02 1C 0F
			39 01 00 00 00 00 02 1D 20
			39 01 00 00 00 00 02 1E 20
			39 01 00 00 00 00 02 1F 20
			39 01 00 00 00 00 02 20 20
			39 01 00 00 00 00 02 21 17
			39 01 00 00 00 00 02 22 15
			39 01 00 00 00 00 02 23 13
			39 01 00 00 00 00 02 2F 04
			39 01 00 00 00 00 02 30 08
			39 01 00 00 00 00 02 31 04
			39 01 00 00 00 00 02 32 08
			39 01 00 00 00 00 02 33 02
			39 01 00 00 00 00 02 34 02
			39 01 00 00 00 00 02 35 00
			39 01 00 00 00 00 02 37 02
			39 01 00 00 00 00 02 38 72
			39 01 00 00 00 00 02 39 72
			39 01 00 00 00 00 02 3B 40
			39 01 00 00 00 00 02 3F 72
			39 01 00 00 00 00 02 60 10
			39 01 00 00 00 00 02 61 00
			39 01 00 00 00 00 02 68 83
			39 01 00 00 00 00 02 78 00
			39 01 00 00 00 00 02 79 00
			39 01 00 00 00 00 02 7A 08
			39 01 00 00 00 00 02 7B 9C
			39 01 00 00 00 00 02 7D 06
			39 01 00 00 00 00 02 7E 02
			39 01 00 00 00 00 02 80 45
			39 01 00 00 00 00 02 81 06
			39 01 00 00 00 00 02 8E F0
			39 01 00 00 00 00 02 90 00
			39 01 00 00 00 00 02 92 76
			39 01 00 00 00 00 02 93 0A
			39 01 00 00 00 00 02 94 0A
			39 01 00 00 00 00 02 99 33
			39 01 00 00 00 00 02 9B FF
			39 01 00 00 00 00 02 B3 00
			39 01 00 00 00 00 02 B4 04
			39 01 00 00 00 00 02 B5 04
			39 01 00 00 00 00 02 DC 00
			39 01 00 00 00 00 02 DD 01
			39 01 00 00 00 00 02 DE 00
			39 01 00 00 00 00 02 DF 00
			39 01 00 00 00 00 02 E0 75
			39 01 00 00 00 00 02 E9 08
			39 01 00 00 00 00 02 ED 40
                        39 01 00 00 00 00 02 FF 20
                        39 01 00 00 00 00 02 FB 01
                        39 01 00 00 00 00 11 B0 00 00 00 15 00 37 00 54 00 6D 00 84 00 98 00 AC
                        39 01 00 00 00 00 11 B1 00 BD 00 F9 01 25 01 6B 01 9C 01 EC 02 22  02 25
                        39 01 00 00 00 00 11 B2 02 5E 02 9E 02 C9 02 FD 03 21 03 4D 03 5A 03 68
                        39 01 00 00 00 00 0D B3 03 78 03 8B 03 A1 03 BD 03 D6 03 DA
                        39 01 00 00 00 00 11 B4 00 00 00 15 00 37 00 54 00 6D 00 84 00 98 00 AC
                        39 01 00 00 00 00 11 B5 00 BD 00 F9 01 25 01 6B 01 9C 01 EC 02 22  02 25
                        39 01 00 00 00 00 11 B6 02 5E 02 9E 02 C9 02 FD 03 21 03 4D 03 5A 03 68
                        39 01 00 00 00 00 0D B7 03 78 03 8B 03 A1 03 BD 03 D6 03 DA
                        39 01 00 00 00 00 11 B8 00 00 00 15 00 37 00 54 00 6D 00 84 00 98 00 AC
                        39 01 00 00 00 00 11 B9 00 BD 00 F9 01 25 01 6B 01 9C 01 EC 02 22  02 25
                        39 01 00 00 00 00 11 BA 02 5E 02 9E 02 C9 02 FD 03 21 03 4D 03 5A 03 68
                        39 01 00 00 00 00 0D BB 03 78 03 8B 03 A1 03 BD 03 D6 03 DA
                        39 01 00 00 00 00 02 FF 21
                        39 01 00 00 00 00 02 FB 01
                        39 01 00 00 00 00 11 B0 00 00 00 15 00 37 00 54 00 6D 00 84 00 98 00 AC
                        39 01 00 00 00 00 11 B1 00 BD 00 F9 01 25 01 6B 01 9C 01 EC 02 22  02 25
                        39 01 00 00 00 00 11 B2 02 5E 02 9E 02 C9 02 FD 03 21 03 4D 03 5A 03 68
                        39 01 00 00 00 00 0D B3 03 78 03 8B 03 A1 03 BD 03 D6 03 DA
                        39 01 00 00 00 00 11 B4 00 00 00 15 00 37 00 54 00 6D 00 84 00 98 00 AC
                        39 01 00 00 00 00 11 B5 00 BD 00 F9 01 25 01 6B 01 9C 01 EC 02 22  02 25
                        39 01 00 00 00 00 11 B6 02 5E 02 9E 02 C9 02 FD 03 21 03 4D 03 5A 03 68
                        39 01 00 00 00 00 0D B7 03 78 03 8B 03 A1 03 BD 03 D6 03 DA
                        39 01 00 00 00 00 11 B8 00 00 00 15 00 37 00 54 00 6D 00 84 00 98 00 AC
                        39 01 00 00 00 00 11 B9 00 BD 00 F9 01 25 01 6B 01 9C 01 EC 02 22  02 25
                        39 01 00 00 00 00 11 BA 02 5E 02 9E 02 C9 02 FD 03 21 03 4D 03 5A 03 68
                        39 01 00 00 00 00 0D BB 03 78 03 8B 03 A1 03 BD 03 D6 03 DA
			39 01 00 00 00 00 02 FF 25
			39 01 00 00 00 00 02 FB 01
			39 01 00 00 00 00 02 05 0C
			39 01 00 00 00 00 02 0A 81
			39 01 00 00 00 00 02 0B D7
			39 01 00 00 00 00 02 0C 01
			39 01 00 00 00 00 02 17 82
			39 01 00 00 00 00 02 21 1C
			39 01 00 00 00 00 02 22 1C
			39 01 00 00 00 00 02 24 76
			39 01 00 00 00 00 02 25 76
			39 01 00 00 00 00 02 5C 25
			39 01 00 00 00 00 02 5D 80
			39 01 00 00 00 00 02 5E 80
			39 01 00 00 00 00 02 5F 22
			39 01 00 00 00 00 02 65 00
			39 01 00 00 00 00 02 69 60
			39 01 00 00 00 00 02 6B 00
			39 01 00 00 00 00 02 71 2D
			39 01 00 00 00 00 02 80 00
			39 01 00 00 00 00 02 8D 04
			39 01 00 00 00 00 02 D7 00
			39 01 00 00 00 00 02 D8 00
			39 01 00 00 00 00 02 D9 00
			39 01 00 00 00 00 02 DA 00
			39 01 00 00 00 00 02 DB 00
			39 01 00 00 00 00 02 DC 00
			39 01 00 00 00 00 02 FF 26
			39 01 00 00 00 00 02 FB 01
			39 01 00 00 00 00 02 06 C8
			39 01 00 00 00 00 02 12 5A
			39 01 00 00 00 00 02 19 0A
			39 01 00 00 00 00 02 1A 97
			39 01 00 00 00 00 02 1D 0A
			39 01 00 00 00 00 02 1E 1E
			39 01 00 00 00 00 02 99 20
			39 01 00 00 00 00 02 FF 27
			39 01 00 00 00 00 02 FB 01
			39 01 00 00 00 00 02 13 0E
			39 01 00 00 00 00 02 16 B0
			39 01 00 00 00 00 02 17 D0
			39 01 00 00 00 00 02 FF 10
			39 01 00 00 00 00 02 FB 01
			05 01 00 00 46 00 02 11 00
			05 01 00 00 0A 00 02 29 00];
		qcom,mdss-dsi-off-command = [05 01 00 00 32 00 02 28 00
					05 01 00 00 78 00 02 10 00];
		qcom,mdss-dsi-esd-recover-command = [39 01 00 00 00 00 02 4F 01];
		qcom,mdss-dsi-on-command-state = "dsi_lp_mode";
		qcom,mdss-dsi-off-command-state = "dsi_lp_mode";
		qcom,mdss-dsi-esd-recover-command-state = "dsi_lp_mode";
		qcom,mdss-dsi-h-sync-pulse = <1>;
		qcom,mdss-dsi-traffic-mode = "burst_mode";
		qcom,mdss-dsi-lane-map = "lane_map_0123";
		qcom,mdss-dsi-bllp-eof-power-mode;
		qcom,mdss-dsi-bllp-power-mode;
		qcom,mdss-dsi-lane-0-state;
		qcom,mdss-dsi-lane-1-state;
		qcom,mdss-dsi-lane-2-state;
		qcom,mdss-dsi-lane-3-state;
		qcom,mdss-dsi-panel-timings-phy-v2 = [25 20 09 0A 06 03 04 a0
		25 20 09 0A 06 03 04 a0
		25 20 09 0A 06 03 04 a0
		25 20 09 0A 06 03 04 a0
		25 1F 09 0A 06 03 04 a0];
		qcom,mdss-dsi-t-clk-post = <0x1E>;
		qcom,mdss-dsi-t-clk-pre = <0x38>;
		qcom,mdss-dsi-bl-min-level = <1>;
		qcom,mdss-dsi-bl-max-level = <3259>;
		qcom,mdss-dsi-dma-trigger = "trigger_sw";
		qcom,mdss-dsi-mdp-trigger = "none";
		qcom,mdss-dsi-bl-pmic-control-type = "bl_ctrl_wled";
		//qcom,mdss-dsi-reset-sequence = <1 20>, <0 15>, <1 20>;
		//qcom,mdss-dsi-reset-sequence = <1 50>, <0 50>, <1 100>, <0 50>, <1 50>;
		qcom,mdss-dsi-reset-sequence = <1 10>, <0 10>, <1 10>, <0 10>, <1 20>;
		//qcom,mdss-dsi-lp11-init;
		//qcom,mdss-dsi-init-delay-us = <10000>;
		qcom,ulps-enabled;
		qcom,panel-allow-phy-poweroff;
	};
};
