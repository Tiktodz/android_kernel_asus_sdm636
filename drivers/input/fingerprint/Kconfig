## drivers/input/fingerprint/Kconfig
```kconfig
#
# Fingerprint driver configuration
#

if MACH_ASUS_X01BD

menuconfig INPUT_FINGERPRINT
	bool "Fingerprint"
	help
	  Say Y here, and a list of supported fingerprint will be displayed.
	  This option doesn't affect the kernel.

	  If unsure, say Y.

if INPUT_FINGERPRINT

config CDFINGER_FP
	bool "Fingerprint cdfinger"
	help
	  Say Y here if you use common fp.
	  If unsure, say N.

config FOCALTECH_FP
	bool "Fingerprint focaltech"
	help
	  Say Y here if you use focaltech fp.
	  If unsure, say N.

endif

endif
```

## drivers/misc/huaqin/Kconfig
```kconfig
#
# for huaqin mis info
#

# Huaqin add for ZQL1650-86 by liunianliang at 2018/02/09 start
config HQ_HARDWARE_INFO
	bool "show hardware info"
        default y
	help
	  this will create proc/hardwareinfo to show some hardware information.

	  If unsure, say N.
# Huaqin add for ZQL1650-86 by liunianliang at 2018/02/09 end

# Huaqin add for ZQL1650-1179 by liunianliang at 2018/04/20 start
config HQ_SIM_TRAY_CHECK
	bool "check sim stry status"
        default y
	help
	  this will create a node to show sim tray status.

	  If unsure, say N.
# Huaqin add for ZQL1650-1179 by liunianliang at 2018/04/20 end
```

## drivers/platform/asus/Kconfig
```kconfig
# Asus board options

menu "Asus board selection"
config MACH_ASUS_SDM660_FAMILY
	bool "ASUS SDM660 Family"
	depends on ARCH_SDM660
	help
	  Add support for ASUS sdm660 board options


config MACH_ASUS_X00T
	bool "ZenFone Max Pro M1 board (X00T)"
	select MACH_ASUS_SDM660_FAMILY
	help
	  Support for Asus ZB601KL/ZB602KL

endmenu
```

## drivers/sensors/Kconfig
```kconfig
config SENSORS_SSC
	bool "Enable Sensors Driver Support for SSC"
	help
	  Add support for sensors SSC driver.
	  This driver is used for exercising sensors use case,
	  time syncing with ADSP clock.

config SENSORS_CLASS
	bool "Sensors Class Support"
	help
	  This option enables the sensor sysfs class in /sys/class/sensors.
	  You'll need this to do anything useful with sensors.

	  If unsure, say N.

config INPUT_STK3335
	tristate "STK STK3335 alsps sensor"
	depends on MACH_ASUS_X01BD && I2C
	select SENSORS_CLASS
	help
	  Say Y here to enable the STK3335 ALSPS Sensor.

config INPUT_STK3321
	tristate "STK STK3321 alsps sensor"
	depends on MACH_ASUS_X00TD && I2C
	select SENSORS_CLASS
	help
	  Say Y here to enable the STK3321 ALSPS Sensor.
```
